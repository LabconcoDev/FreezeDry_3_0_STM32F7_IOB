## my-app/boards/lcc_rpi_carrier_stm32f723/Kconfig.lcc_rpi_carrier_stm32f723
```kconfig
config BOARD_LCC_RPI_CARRIER_STM32F723
    bool "LCC RPi Carrier STM32F723"
    select SOC_STM32F723XX
    select ADC_CONFIGURABLE_INPUTS
    select ADC_CONFIGURABLE_EXCITATION_CURRENT_SOURCE_PIN
    select ADC_CONFIGURABLE_VBIAS_PIN

config BOARD
    default "lcc_rpi_carrier_stm32f723"
```

## my-app/boards/lcc_rpi_carrier_stm32f723/board.yml
```yaml
board:
  name: lcc_rpi_carrier_stm32f723
  full_name: LCC Raspberry Pi Carrier STM32F723
  vendor: lcc
  socs:
    - name: stm32f723xx
```

## my-app/boards/lcc_rpi_carrier_stm32f723/lcc_rpi_carrier_stm32f723_defconfig
```kconfig
CONFIG_GPIO=y
CONFIG_SERIAL=y
CONFIG_UART_INTERRUPT_DRIVEN=y
CONFIG_I2C=y
CONFIG_SPI=y

CONFIG_CONSOLE=y
CONFIG_UART_CONSOLE=y
```
